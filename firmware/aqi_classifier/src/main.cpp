// Stage 2 firmware: AQI CLASSIFIER
// firmware/aqi_classifier/src/main.cpp (PlatformIO project, ESP32-S3-DevKitC-1 N16R8)
// Pipeline per 3 s cycle: PMS5003 + DHT22 -> humidity correction -> model input scaling -> INT8
// TensorFlow Lite Micro inference -> LCD (PM2.5, time, class) + CSV row on microSD + serial status.
// Everything the stage 1 logger learned on the bench is in the modules next to this file:
//   node_hw      hardware objects, I2C roll call and bus verdicts, LCD re-init
//   rtc_time     validated DS1307 reads, uptime fallback, T= time set
//   sd_store     own file per header, card remount + RAM ring buffer, no row lost on a dropout
//   power_meter  checked INA219 register reads and the shunt-across-a-rail guard
//   sensors      fresh PMS5003 frame, humidity correction
//   inference    TFLM interpreter, per-tensor model guard, input scaling, classify
//   benchmark    latency / RAM / energy protocol (BENCHMARK_MODE in config.h, or serial BENCH)
//   serial_cmd   T= / F= / BENCH line commands
// Requires aqi_model.h in the project root (generated by code/04_tinyml_model/requantize_int8.py).

#include <Arduino.h>
#include <Wire.h>
#include <string.h>
#include <math.h>
#include "config.h"
#include "node_hw.h"
#include "sd_store.h"
#include "rtc_time.h"
#include "sensors.h"
#include "power_meter.h"
#include "inference.h"
#include "benchmark.h"
#include "serial_cmd.h"

static const char* CSV_HEADER =
  "timestamp,pm25_raw,pm25_corr,pm10,temp_c,rh_pct,aqi_class,confidence,latency_ms,bus_V,current_mA";
static const uint32_t TEST_POLL_MS = 1;

struct Cycle {
  char ts[20]; bool tsFromRtc;
  PmsReading pms; float temp, rh, pm25c; bool dhtOk;
  int cls; float conf; uint32_t latUs;
  float busV, curr;
};

static void readCycle(Cycle& c) {
  c.pms  = readPMS();
  c.temp = dht.readTemperature();
  c.rh   = dht.readHumidity();
  c.dhtOk = !isnan(c.temp) && !isnan(c.rh);
  inaRead(c.busV, c.curr);
  c.tsFromRtc = rtcTimestamp(c.ts, sizeof(c.ts));
  c.cls = -1; c.conf = 0.0f; c.latUs = 0;
  c.pm25c = humidityCorrect((float)c.pms.pm25, c.rh);
  if (!c.pms.ok || !c.dhtOk) return;   // the model needs all four features
  float raw[kNumFeatures] = { c.pm25c, (float)c.pms.pm10, c.temp, c.rh };
  float probs[kNumClasses];
  c.cls = classify(raw, probs, &c.latUs);
  if (c.cls >= 0) c.conf = probs[c.cls];
}

static bool storeBehind() { return !sdOk || sdPendingCount() > 0; }

static void showOnLcd(const Cycle& c) {
  lcd.clear();
  char hhmm[6] = "--:--";
  if (c.tsFromRtc) strlcpy(hhmm, c.ts + 11, sizeof(hhmm));
  lcd.setCursor(0, 0); lcd.printf("PM2.5:%4u %s", c.pms.pm25, hhmm);
  lcd.setCursor(0, 1);
  if (c.cls >= 0)    lcd.printf("%-11s%3.0f%%", AQI_SHORT[c.cls], c.conf * 100.0f);
  else if (!c.dhtOk) lcd.print("no T/RH: no cls");
  else               lcd.print("inference error");
  if (storeBehind()) { lcd.setCursor(15, 1); lcd.print("!"); }   // rows waiting in RAM
  if (inaShort)      { lcd.setCursor(0, 1); lcd.print("INA SHORT unplug"); }
}

// A PMS frame is enough for a row: a failed DHT read is written as nan and an empty class
// (decision 2026-11-01), so dust data is never lost when one sensor glitches.
static void logRow(const Cycle& c) {
  char cls[12] = "", conf[16] = "", lat[16] = "";
  if (c.cls >= 0) {
    snprintf(cls, sizeof(cls), "%d", c.cls);
    snprintf(conf, sizeof(conf), "%.3f", c.conf);
    snprintf(lat, sizeof(lat), "%.3f", c.latUs / 1000.0f);
  }
  char row[SD_ROW_BYTES];
  int n = snprintf(row, sizeof(row), "%s,%u,%.1f,%u,%.1f,%.1f,%s,%s,%s,%.2f,%.1f\n",
                   c.ts, c.pms.pm25, c.pm25c, c.pms.pm10, c.temp, c.rh, cls, conf, lat, c.busV, c.curr);
  if (n < 0 || n >= (int)sizeof(row)) {   // real rows stay under ~85 B; keep the line intact regardless
    row[sizeof(row) - 2] = '\n'; row[sizeof(row) - 1] = '\0';
    Serial.println("WARN: CSV row truncated (implausible sensor value)");
  }
  sdStore(row);
}

static void printStatus(const Cycle& c) {
  char cls[48];
  if (c.cls >= 0)    snprintf(cls, sizeof(cls), "  class=%s (%.3f) lat=%.2fms", AQI_SHORT[c.cls], c.conf, c.latUs / 1000.0f);
  else if (!c.dhtOk) strlcpy(cls, "  class=none (no T/RH)", sizeof(cls));
  else               strlcpy(cls, "  class=ERR (inference failed)", sizeof(cls));
  char ina[32] = "";
  if (inaOk) snprintf(ina, sizeof(ina), " ina=%.2fV/%.0fmA", c.busV, c.curr);
  char sd[40] = "";
  if (sdPendingCount() || sdDroppedCount())
    snprintf(sd, sizeof(sd), " pending=%u dropped=%u", (unsigned)sdPendingCount(), (unsigned)sdDroppedCount());
  // when the RTC or DHT is missing, say whether the RTC module's EEPROM (same four wires as the
  // DS1307) still answers and whether the DHT data line still sees its 10 k pull-up
  char diag[64] = "";
  if (!rtcOk || !c.dhtOk)
    snprintf(diag, sizeof(diag), "  [rtc_eeprom=%d dht_line=%s]", i2cAck(RTC_EEPROM_ADDR), c.dhtOk ? "ok" : lineState(DHT_PIN));
  else if (!c.tsFromRtc && rtcTimeLost())
    strlcpy(diag, "  [rtc time lost: send T=]", sizeof(diag));
  else if (!c.tsFromRtc)
    snprintf(diag, sizeof(diag), "  [rtc read failed: %s]", rtcLastError());
  Serial.printf("%s  PM2.5=%u PM10=%u T=%.1f RH=%.1f%s  bus: lcd=%d rtc=%d sd=%d%s%s%s\n",
                c.ts, c.pms.pm25, c.pms.pm10, c.temp, c.rh, cls, lcdOk, rtcOk, sdOk, sd, ina, diag);
}

// Keep the 3 s cadence and answer serial commands (F= test vectors, BENCH, T=) while waiting.
static void waitForNextCycle(uint32_t cycle_start) {
  while (millis() - cycle_start < SAMPLE_INTERVAL_MS) { serialService(); delay(5); }
}

void setup() {
  Serial.begin(115200);
  Wire.begin(SDA_PIN, SCL_PIN);
  Wire.setClock(I2C_CLOCK_HZ);
  pmsSerial.begin(PMS_BAUD, SERIAL_8N1, PMS_RX_PIN, PMS_TX_PIN);
  dht.begin();

  lcdOk = (lcd.begin(LCD_COLS, LCD_ROWS) == 0);
  if (!lcdOk) Serial.println("WARN: LCD not found on I2C (check shifter HV side / LCD 5 V)");
  lcd.backlight(); lcd.print("AQI Classifier");

  char err[48];
  if (!tflmInit(err, sizeof(err))) haltWithError(err);
  Serial.printf("TFLM ready: model %u B in flash (crc32 %08lx, inputs crc32 %08lx), arena used %u of %u B, heap delta %d B\n",
                (unsigned)tflmModelBytes(), (unsigned long)tflmModelCrc32(), (unsigned long)tflmInputCrc32(),
                (unsigned)tflmArenaUsed(), (unsigned)tflmArenaSize(), tflmHeapDelta());

  rtcBegin();
  inaBegin();
  i2cRollCall(lcdOk);

#if BENCHMARK_MODE
  // before the card mount, so a missing card cannot block the benchmark
  runBenchmarks();
  lcd.clear(); lcd.print("Benchmarks done");
  while (true) { serialService(); delay(5); }   // BENCH can be re-run from bench_capture.py
#endif

  sdMountBlocking(CLS_LOG_FILE, CSV_HEADER, serialService);   // answers MODEL / F= / BENCH while it waits
  Serial.println("Classifier ready. Serial: T=YYYY-MM-DD HH:MM:SS | F=<id>,pm25,pm10,temp,rh | BENCH | MODEL");
}

void loop() {
  if (serialTestActive()) { serialService(); delay(TEST_POLL_MS); return; }   // verification run
  uint32_t cycle_start = millis();
  rtcService();
  inaService();
  lcdService();
  serialService();

  Cycle c = {};
  readCycle(c);
  if (c.pms.ok) {
    logRow(c);
    showOnLcd(c);
    printStatus(c);
  } else {
    sdService();   // a backlog still drains while the PMS5003 is out
    lcd.clear(); lcd.print("PMS5003 error");
    if (storeBehind()) { lcd.setCursor(15, 1); lcd.print("!"); }
    Serial.printf("%s  read error (pms=%d dht=%d)  bus: lcd=%d rtc=%d sd=%d\n",
                  c.ts, c.pms.ok, c.dhtOk, lcdOk, rtcOk, sdOk);
  }
  waitForNextCycle(cycle_start);
}
